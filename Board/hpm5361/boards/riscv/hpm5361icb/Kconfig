## Board/hpm5361/boards/riscv/hpm5361icb/Kconfig
```kconfig
# Copyright (c) 2026 HPMicro
# SPDX-License-Identifier: Apache-2.0

config BOARD_HPM5361ICB
	select SOC_HPM5361
```

## Board/hpm5361/boards/riscv/hpm5361icb/Kconfig.defconfig
```kconfig
# Copyright (c) 2026 HPMicro
# SPDX-License-Identifier: BSD-3-Clause

if BOARD_HPM5361ICB

config HEAP_MEM_POOL_SIZE
	default 16384

config BUILD_OUTPUT_HEX
	default y

config UART_INTERRUPT_DRIVEN
	default y

endif # BOARD_HPM5361ICB
```

## Board/hpm5361/boards/riscv/hpm5361icb/board.yml
```yaml
board:
  name: hpm5361icb
  full_name: HPM5361 Custom Controller Board
  vendor: hpmicro
  socs:
    - name: hpm5361
```

## Kconfig
```kconfig
mainmenu "Dust HeavyHero"

source "Kconfig.zephyr"
rsource "Device/remote/Kconfig"
rsource "Device/imu/Kconfig"
```
