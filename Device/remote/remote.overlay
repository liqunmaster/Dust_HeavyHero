/ {
    aliases {
        dt7-uart = &uart4;
        vt02-uart = &uart1;
        vt03-uart = &uart1;
    };
};

&uart1 {
    current-speed = <921600>;
    data-bits = <8>;
    stop-bits = "1";
    parity = "none";
    dmas = <&hdma 0 0x16>, <&hdma 1 0x17>;
    dma-names = "rx", "tx";
    status = "okay";
};

&uart4 {
    current-speed = <100000>;
    data-bits = <8>;
    stop-bits = "1";
    parity = "even";
    dmas = <&hdma 4 0x1c>, <&hdma 5 0x1d>;
    dma-names = "rx", "tx";
    status = "okay";
};
